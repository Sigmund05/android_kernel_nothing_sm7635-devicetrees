/dts-v1/;
/plugin/;

#include "neo-aliso-sg2-idp-pm8008.dtsi"

/ {
	model = "Qualcomm Technologies, Inc.neo-aliso-sg2-idp-pm8008 SINGLE Display and 12MP CAMERA SUPPORT";
	compatible = "qcom,neo";
	qcom,msm-id = <740 0x10000>;
	qcom,board-id = <34 3>;
};
