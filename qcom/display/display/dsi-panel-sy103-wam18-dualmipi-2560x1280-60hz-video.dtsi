&mdss_mdp {
	dsi_sy103_wam18_dual_2560x1280_60hz_video: qcom,mdss_dsi_sy103_wam18_dual_2560x1280_60hz_video {
		qcom,mdss-dsi-panel-name =
			"sy103 wam18 amoled video mode panel without DSC";
		qcom,mdss-dsi-panel-type = "dsi_video_mode";
		qcom,mdss-dsi-panel-physical-type = "oled";
		qcom,mdss-dsi-virtual-channel-id = <0>;
		qcom,mdss-dsi-stream = <0>;
		qcom,mdss-dsi-bpp = <24>;
		qcom,mdss-dsi-border-color = <0>;
		qcom,dsi-ctrl-num = <0 1>;
		qcom,dsi-phy-num = <0 1>;
		qcom,mdss-dsi-traffic-mode = "non_burst_sync_event";
		qcom,mdss-dsi-bllp-eof-power-mode;
		qcom,mdss-dsi-bllp-power-mode;
		qcom,mdss-dsi-lane-0-state;
		qcom,mdss-dsi-lane-1-state;
		qcom,mdss-dsi-lane-2-state;
		qcom,mdss-dsi-lane-3-state;
		qcom,mdss-dsi-dma-trigger = "trigger_sw";
		qcom,mdss-dsi-mdp-trigger = "none";
		qcom,mdss-dsi-reset-sequence = <1 10>, <0 10>, <1 20>;

		qcom,mdss-dsi-display-timings {
			timing@0 {
				cell-index = <0>;
				qcom,mdss-dsi-panel-framerate = <60>;
				qcom,mdss-dsi-panel-width = <1280>;
				qcom,mdss-dsi-panel-height = <1280>;
				qcom,mdss-dsi-h-front-porch = <64>;
				qcom,mdss-dsi-h-back-porch = <32>;
				qcom,mdss-dsi-h-pulse-width = <32>;
				qcom,mdss-dsi-h-sync-skew = <0>;
				qcom,mdss-dsi-v-back-porch = <8>;
				qcom,mdss-dsi-v-front-porch = <16>;
				qcom,mdss-dsi-v-pulse-width = <2>;
				qcom,mdss-dsi-h-left-border = <0>;
				qcom,mdss-dsi-h-right-border = <0>;
				qcom,mdss-dsi-v-top-border = <0>;
				qcom,mdss-dsi-v-bottom-border = <0>;

				qcom,mdss-dsi-on-command = [
					15 01 00 00 00 00 02 03 80
					15 01 00 00 00 00 02 53 29
					39 01 00 00 00 00 03 51 FF 01
					15 01 00 00 00 00 02 69 01
					15 01 00 00 00 00 02 6B 00
					39 01 00 00 00 00 05 80 01 40 40 11
					39 01 00 00 00 00 08 81 02 56 00 0A 00 10 00
					39 01 00 00 00 00 08 82 02 56 00 0A 00 10 00
					15 01 00 00 00 00 02 25 01
					15 01 00 00 00 00 02 35 00
					15 01 00 00 00 00 02 22 00
					39 01 00 00 00 00 03 F0 AA 11
					39 01 00 00 00 00 04 C0 00 04 00
					39 01 00 00 00 00 08 C2 02 CC 02 CC 00 90 82
					39 01 00 00 00 00 03 FF 5A 81
					15 01 00 00 00 00 02 65 0B
					39 01 00 00 00 00 0E F9 74 79 7E 83 88 8D 92 97 9C A1 A6 AB B0
					39 01 00 00 00 00 03 F0 AA 12
					15 01 00 00 00 00 02 D3 20
					39 01 00 00 00 00 08 C2 C1 02 51 00 08 00 94
					39 01 00 00 00 00 03 FF 5A 81
					15 01 00 00 00 00 02 65 09
					15 01 00 00 00 00 02 F3 01
					15 01 00 00 00 00 02 65 3B
					15 01 00 00 00 00 02 F7 39
					15 01 00 00 00 00 02 65 05
					15 01 00 00 00 00 02 F2 00
					05 01 00 00 32 00 01 11
					05 01 00 00 00 00 01 29
					15 01 00 00 00 00 02 13 00
					39 01 00 00 00 00 03 F0 AA 11
					15 01 00 00 00 00 02 C0 FF
				];

				qcom,mdss-dsi-off-command = [
					05 01 00 00 14 00 02 28 00
					05 01 00 00 78 00 02 10 00
				];
				qcom,mdss-dsi-on-command-state = "dsi_lp_mode";
				qcom,mdss-dsi-off-command-state = "dsi_hs_mode";
				qcom,mdss-dsi-h-sync-pulse = <0>;
			};
		};
	};
};
