/dts-v1/;
/plugin/;

#include "neo-aliso-sg2-sde-display-idp.dtsi"

/ {
	model = "Qualcomm Technologies, Inc. NEO LUNA-V2 DD";
	compatible = "qcom,neo";
	qcom,msm-id = <740 0x10000>;
	qcom,board-id = <34 2>, <33 1>, <34 3>;
};
