/dts-v1/;
/plugin/;

#include "neo-aliso-sg-idp-pm8008.dtsi"

/ {
	model = "Qualcomm Technologies,Inc.neo-aliso-sg-idp-pm8008.dts";
	compatible = "qcom,neo-idp", "qcom,neo", "qcom,idp";
	qcom,msm-id = <739 0x10000>;
	qcom,board-id = <34 3>;
};
