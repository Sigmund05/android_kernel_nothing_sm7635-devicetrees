/dts-v1/;

#include "lemans-gunyah-vm-lv.dtsi"
#include "lemans-gunyah-vm-lv-qcvirtio.dtsi"

/ {
	model = "Qualcomm Technologies, Inc. Lemans IVI ADAS COB Gunyah LV VM QCVirtIO";
	compatible = "qcom,lemans", "qcom,cob";
	qcom,board-id = <0x10019 0x0>;
};
