/dts-v1/;
/plugin/;

#include "neo_aliso-sg2-kiwi-cnss.dtsi"

/ {
	model = "Qualcomm Technologies, Inc. NEO IDP HMT";
	compatible = "qcom,neo-idp", "qcom,neo", "qcom,idp", "qcom,neo-atp", "qcom,atp", "qcom,neo-qar", "qcom,qar";
	qcom,msm-id = <740 0x10000>;
	qcom,board-id = <33 1>, <34 2>, <44 1>;
};
